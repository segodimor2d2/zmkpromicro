/ {
    keymap_transform_custom: keymap_transform_custom {
        compatible = "zmk,keymap-transform";
        rows = <4>;
        cols = <12>;
        map = <
            0x0  0x1  0x2  0x3  0x4  0x5  0x6  0x7  0x8  0x9  0xa  0xb
            0x100 0x101 0x102 0x103 0x104 0x105 0x106 0x107 0x108 0x109 0x10a 0x10b
            0x200 0x201 0x202 0x203 0x204 0x205 0x206 0x207 0x208 0x209 0x20a 0x20b
            0x300 0x301 0x302 0x303 0x304 0x305 0x306 0x307 0x308 0x309 0x30a 0x30b
        >;
    };
};
